## config/boards/shields/skinner47_dongle/Kconfig.defconfig
```kconfig
# Copyright (c) 2024 The ZMK Contributors
# SPDX-License-Identifier: MIT

if SHIELD_SKINNER47_DONGLE

config ZMK_KEYBOARD_NAME
    default "SKINNER47"

config ZMK_BLE
    default y

config ZMK_USB
    default y

config BT
    default y

config ZMK_SPLIT_ROLE_CENTRAL
    default y

config ZMK_SPLIT
    default y

config ZMK_SPLIT_BLE_CENTRAL_PERIPHERALS
    default 2

config BT_MAX_CONN
    default 7

config BT_MAX_PAIRED
    default 7

config ZMK_MOUSE
    default y

config INPUT
    default y

config ZMK_SPLIT_BLE_CENTRAL_BATTERY_LEVEL_FETCHING
    default y

config ZMK_SPLIT_BLE_CENTRAL_BATTERY_LEVEL_PROXY
    default y

config ZMK_STUDIO
    default y

config ZMK_STUDIO_LOCKING
    default n

endif
```

## config/boards/shields/skinner47_dongle/Kconfig.shield
```kconfig
# Copyright (c) 2024 The ZMK Contributors
# SPDX-License-Identifier: MIT

config SHIELD_SKINNER47_DONGLE
    def_bool $(shields_list_contains,skinner47_dongle)
```

## config/boards/shields/skinner47_peripheral/Kconfig.defconfig
```kconfig
if SHIELD_SKINNER47_PERIPHERAL

config ZMK_SPLIT_ROLE_CENTRAL
    default n

endif
```

## config/boards/shields/skinner47_peripheral/Kconfig.shield
```kconfig
config SHIELD_SKINNER47_PERIPHERAL
    def_bool $(shields_list_contains,skinner47_peripheral)
```

## config/dts/bindings/zmk,behavior-os-switch.yaml
```yaml
description: "Custom ZMK behavior to select binding based on active operating system state"
compatible: "zmk,behavior-os-switch"
properties:
  "#binding-cells":
    type: int
    const: 0
  mac-bindings:
    type: phandle-array
    required: true
    specifier-space: binding
  win-bindings:
    type: phandle-array
    required: true
    specifier-space: binding
  lin-bindings:
    type: phandle-array
    required: true
    specifier-space: binding
```

## config/dts/bindings/zmk,behavior-set-lang.yaml
```yaml
compatible: "zmk,behavior-set-lang"
properties:
  "#binding-cells":
    type: int
    const: 1
```

## config/dts/bindings/zmk,behavior-set-os.yaml
```yaml
description: "Custom ZMK behavior to set the active operating system state"
compatible: "zmk,behavior-set-os"
properties:
  "#binding-cells":
    type: int
    const: 1

binding-cells:
  - param1
```
